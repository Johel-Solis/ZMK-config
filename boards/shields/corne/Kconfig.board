## boards/shields/corne/Kconfig.board
```kconfig
config BOARD_CORNE_LEFT
    bool "corne left v2"
    depends on SOC_NRF52840_QIAA
    select BOARD_CORNE_LEFT

config BOARD_CORNE_RIGHT
    bool "corne right v2"
    depends on SOC_NRF52840_QIAA
    select BOARD_CORNE_RIGHT
```

## boards/shields/corne/Kconfig.defconfig
```kconfig
if SHIELD_CORNE_LEFT

config ZMK_KEYBOARD_NAME
	default "Corne"

config ZMK_SPLIT_ROLE_CENTRAL
    default y

config ZMK_SPLIT_BLE_ROLE_CENTRAL
	default y

endif

if SHIELD_CORNE_LEFT || SHIELD_CORNE_RIGHT

config BOARD
    default "corne_"

config ZMK_SPLIT
    default y

config BT_CTLR
    default BT

if ZMK_DISPLAY

config I2C
    default y

config SSD1306
    default y

endif # ZMK_DISPLAY

if USB

config USB_NRFX
    default y

config USB_DEVICE_STACK
    default y

endif # USB

endif
```

## boards/shields/corne/Kconfig.shield
```kconfig
config SHIELD_CORNE_LEFT
  bool
	#def_bool $(shields_list_contains,corne_left)

config SHIELD_CORNE_RIGHT
  bool
	#def_bool $(shields_list_contains,corne_right)
```
